## boards/shields/first36keys/Kconfig.defconfig
```kconfig
if SHIELD_FIRST36KEYS_LEFT

config ZMK_KEYBOARD_NAME
    default "first36keys"

config ZMK_SPLIT_ROLE_CENTRAL
    default y

endif

if SHIELD_FIRST36KEYS_LEFT || SHIELD_FIRST36KEYS_RIGHT

config ZMK_SPLIT
    default y
    
endif
```

## boards/shields/first36keys/Kconfig.shield
```kconfig
config SHIELD_FIRST36KEYS_LEFT
    def_bool $(shields_list_contains,first36keys_left)
    
config SHIELD_FIRST36KEYS_RIGHT
    def_bool $(shields_list_contains,first36keys_right)
```
